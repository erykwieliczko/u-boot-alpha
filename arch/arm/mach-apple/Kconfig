## arch/arm/mach-apple/Kconfig
```kconfig
if ARCH_APPLE

config TEXT_BASE
	default 0x00000000

config SYS_SOC
	default "apple"

config SYS_VENDOR
	default "apple"

config SYS_BOARD
	string "Board name"
	default "mac"
	help
	  This option contains information about board name.
	  Based on this option board/<CONFIG_SYS_VENDOR>/<CONFIG_SYS_BOARD> will
	  be used.
	  Apple silicon based devices are expected to use the generic board name
	  "mac".

config SYS_MALLOC_LEN
	default 0x4000000

config SYS_MALLOC_F_LEN
	default 0x4000

config LNX_KRNL_IMG_TEXT_OFFSET_BASE
	default TEXT_BASE

config WDT_APPLE_PRESERVE_INHERITED_STATE
	bool "Preserve inherited Apple watchdog state"
	depends on WDT_APPLE
	help
	  On supported Apple machines, treat the live watchdog reset-enable bit
	  inherited from the previous boot stage as the sole automated-boot policy.
	  An inherited disabled watchdog remains disabled. An inherited enabled
	  watchdog receives bounded U-Boot and Linux handoff leases without generic
	  cyclic servicing.

config APPLE_PRELOADED_EFI
	bool "Boot an EFI payload appended to U-Boot"
	depends on EFI_LOADER
	help
	  Enable the diagnostic RAM-only EFI boot path. If the incoming device
	  tree contains u-boot,preloaded-efi-address and
	  u-boot,preloaded-efi-size properties in /chosen, U-Boot reserves and
	  starts that image without probing storage. This is intended for early
	  platform and EFI console bring-up.

config APPLE_HANDOFF
	bool
	default y if WDT_APPLE_PRESERVE_INHERITED_STATE || USB_DWC3_APPLE_HANDOFF

endif
```

## configs/apple_j700_defconfig
```kconfig
CONFIG_ARM=y
CONFIG_ARCH_APPLE=y
CONFIG_DEFAULT_DEVICE_TREE="t8140-j700"
# CONFIG_OF_UPSTREAM is not set
CONFIG_ENV_SOURCE_FILE="j700"
# CONFIG_ENV_IS_IN_FAT is not set
CONFIG_ENV_IS_NOWHERE=y
CONFIG_SYS_LOAD_ADDR=0x0
CONFIG_BOOTDELAY=-2
CONFIG_BOOTCOMMAND="echo NEO U-BOOT - KEYBOARD TEST; echo Type: echo NEO-KEYBOARD-OK"
# CONFIG_USE_PREBOOT is not set
# CONFIG_DISPLAY_CPUINFO is not set
CONFIG_DISPLAY_BOARDINFO_LATE=y
CONFIG_BOARD_LATE_INIT=y
CONFIG_CMD_DM=y
CONFIG_CMD_BOOTEFI_HELLO=y
CONFIG_CMD_SELECT_FONT=y
CONFIG_MISC=y
CONFIG_APPLE_MTP_KEYB=y
CONFIG_NO_NET=y
# CONFIG_MMC is not set
CONFIG_USB_XHCI_HCD=y
CONFIG_VIDEO_SIMPLE=y
CONFIG_VIDEO_FONT_16X32=y
CONFIG_SYS_WHITE_ON_BLACK=y
CONFIG_NO_FB_CLEAR=y
# CONFIG_WATCHDOG is not set
# CONFIG_WATCHDOG_AUTOSTART is not set
```

## configs/apple_j713_defconfig
```kconfig
CONFIG_ARM=y
CONFIG_ARCH_APPLE=y
CONFIG_APPLE_PRELOADED_EFI=y
CONFIG_WDT_APPLE_PRESERVE_INHERITED_STATE=y
CONFIG_DEFAULT_DEVICE_TREE="t8132-j713"
CONFIG_SYS_BOOTM_LEN=0x800000
CONFIG_SYS_LOAD_ADDR=0x0
CONFIG_WATCHDOG_TIMEOUT_MSECS=20000
CONFIG_BOOTCOMMAND="bootflow scan -b"
CONFIG_USE_PREBOOT=y
CONFIG_SYS_CBSIZE=256
CONFIG_SYS_PBSIZE=276
# CONFIG_DISPLAY_CPUINFO is not set
CONFIG_DISPLAY_BOARDINFO_LATE=y
CONFIG_BOARD_LATE_INIT=y
CONFIG_CMD_SMBIOS=y
CONFIG_CMD_SELECT_FONT=y
# CONFIG_OF_UPSTREAM is not set
CONFIG_NO_NET=y
CONFIG_SYS_64BIT_LBA=y
CONFIG_APPLE_SPI_KEYB=y
CONFIG_APPLE_MTP_KEYB=y
CONFIG_MISC=y
# CONFIG_MMC is not set
CONFIG_NVME_APPLE=y
CONFIG_SYSINFO=y
CONFIG_SYSINFO_SMBIOS=y
CONFIG_USB_XHCI_HCD=y
CONFIG_USB_XHCI_DWC3=y
CONFIG_USB_XHCI_PCI=y
CONFIG_USB_DWC3=y
CONFIG_USB_DWC3_APPLE_HANDOFF=y
CONFIG_USB_KEYBOARD=y
CONFIG_VIDEO_FONT_16X32=y
CONFIG_SYS_WHITE_ON_BLACK=y
CONFIG_NO_FB_CLEAR=y
CONFIG_VIDEO_SIMPLE=y
# CONFIG_WATCHDOG is not set
# CONFIG_WATCHDOG_AUTOSTART is not set
CONFIG_GENERATE_SMBIOS_TABLE_VERBOSE=y
```
